## conf/distro/tableos.conf
```bitbake
require conf/distro/poky.conf

DSITRO="tableos"
DISTRO_NAME="tableos"
DISTRO_VERSION="1.0"

DISTRO_FEATURES_append = " systemd wifi"
VIRTUAL-RUNTIME_init_manager = "systemd"

DISTRO_FEATURES_BACKFILL_CONSIDERED = "sysvinit"

PACKAGECONFIG_append_pn-systemd = " resolved networkd"
```
